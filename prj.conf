## CMakeLists.txt
```
#
# Copyright (c) 2022 Edge Impulse
#
#

cmake_minimum_required(VERSION 3.13.1)

set(PM_STATIC_YML_FILE ${CMAKE_CURRENT_SOURCE_DIR}/boards/pm_static_${BOARD}.yml)
set(CMAKE_CXX_STANDARD 11)
set(CMAKE_CXX_STANDARD_REQUIRED ON)

list(APPEND ZEPHYR_EXTRA_MODULES ${CMAKE_CURRENT_SOURCE_DIR}/drivers/vm3011 )

########################################################################## 
find_package(Zephyr REQUIRED HINTS $ENV{ZEPHYR_BASE})
project("thingy53_snoring_detection"
          VERSION 0.1)
##########################################################################

add_subdirectory(ei-model/edge-impulse-sdk/cmake/zephyr)

# Needed for colorful output
zephyr_compile_options(-fdiagnostics-color=always)

# Use hardware acceleration for DSP and Neural Network code
# You'll need to disable these on non-Arm cores
add_definitions(-DEIDSP_USE_CMSIS_DSP=1
                -DEIDSP_LOAD_CMSIS_DSP_SOURCES=1
                -DEI_CLASSIFIER_TFLITE_ENABLE_CMSIS_NN=1
                -DEIDSP_QUANTIZE_FILTERBANK=0
                -DARM_MATH_LOOPUNROLL
                -DEI_SENSOR_AQ_STREAM=FILE
                -DMBEDTLS_PLATFORM_ZEROIZE_ALT
                )

# Edge impulse SDK include directories
set(INCLUDES
    .
    drivers
    ei-model
    ei-model/tflite-model
    ei-model/model-parameters
    src
    src/libs/mbedtls_hmac_sha256_sw
    src/libs/QCBOR/inc
    src/libs/QCBOR/src
    src/libs
    )
include_directories(${INCLUDES})

RECURSIVE_FIND_FILE(MODEL_FILES "ei-model/tflite-model" "*.cpp")
RECURSIVE_FIND_FILE(BME68X_FILES "drivers/bme68x" "*.c")
RECURSIVE_FIND_FILE(FIRMWARE_SDK_FILES "firmware-sdk" "*.cpp")
RECURSIVE_FIND_FILE(LIB_QCBOR_FILES "src/libs/QCBOR/src" "*.c")
RECURSIVE_FIND_FILE(LIB_MBEDTLS_FILES "src/libs/mbedtls_hmac_sha256_sw/mbedtls/src" "*.c")
RECURSIVE_FIND_FILE(LIB_SENSOR_AQ_MBEDTLS_FILES "src/libs/sensor_aq_mbedtls" "*.cpp")
RECURSIVE_FIND_FILE(SENSORS_FILES "src/sensors" "*.cpp")
RECURSIVE_FIND_FILE(INFERENCE_FILES "src/inference" "*.cpp")

list(APPEND SOURCE_FILES ${MODEL_FILES})
list(APPEND SOURCE_FILES ${BME68X_FILES})
list(APPEND SOURCE_FILES ${FIRMWARE_SDK_FILES})
list(APPEND SOURCE_FILES ${LIB_QCBOR_FILES})
list(APPEND SOURCE_FILES ${LIB_MBEDTLS_FILES})
list(APPEND SOURCE_FILES ${LIB_SENSOR_AQ_MBEDTLS_FILES})
list(APPEND SOURCE_FILES ${SENSORS_FILES})
list(APPEND SOURCE_FILES ${INFERENCE_FILES})

# add all sources to the project
target_sources(app PRIVATE ${SOURCE_FILES})
target_sources(app PRIVATE src/ble/ei_ble_com.cpp)
target_sources(app PRIVATE src/ble/nus.c)
target_sources(app PRIVATE src/ble/ble_nus.cpp)
target_sources(app PRIVATE src/ei_base64_encode.cpp)
target_sources(app PRIVATE src/ei_at_handlers.cpp)
target_sources(app PRIVATE src/ei_device_thingy53.cpp)
target_sources(app PRIVATE src/ei_sampler.cpp)
target_sources(app PRIVATE src/flash_memory.cpp)
target_sources(app PRIVATE src/buzzer.cpp)
target_sources(app PRIVATE src/main.cpp)

# Preinitialization related to Thingy:53 DFU
target_sources_ifdef(CONFIG_BOARD_THINGY53_NRF5340_CPUAPP app PRIVATE
  boards/thingy53.c
)
```

## prj.conf
```kconfig
#
# Copyright (c) 2022 Edge Impulse
#
################################################################################
# Application configuratin

CONFIG_GPIO=y
# enable c++ support
CONFIG_CPLUSPLUS=y
CONFIG_LIB_CPLUSPLUS=y
CONFIG_NEWLIB_LIBC=y
CONFIG_NEWLIB_LIBC_FLOAT_PRINTF=y

# enable reboot from user space
CONFIG_REBOOT=y

# enable floating point unit
CONFIG_FPU=y

CONFIG_MAIN_STACK_SIZE=8192
CONFIG_HEAP_MEM_POOL_SIZE=16384
CONFIG_SYSTEM_WORKQUEUE_STACK_SIZE=4096
CONFIG_EI_INFERENCE_THREAD_STACK=4096

# serial console
CONFIG_SERIAL=y
CONFIG_UART_INTERRUPT_DRIVEN=y
CONFIG_CONSOLE_SUBSYS=n
CONFIG_CONSOLE_GETCHAR=n
CONFIG_USB_DEVICE_REMOTE_WAKEUP=n

CONFIG_NCS_SAMPLES_DEFAULTS=n
# Logging
CONFIG_ASSERT_NO_COND_INFO=y
CONFIG_ASSERT_NO_MSG_INFO=y
CONFIG_HW_STACK_PROTECTION=y

CONFIG_DEBUG=y
CONFIG_LOG=y
CONFIG_LOG_MODE_DEFERRED=y
CONFIG_LOG_PRINTK=y
CONFIG_LOG_PROCESS_THREAD_STARTUP_DELAY_MS=4000
CONFIG_LOG_BACKEND_UART=n
CONFIG_LOG_BACKEND_RTT=y
CONFIG_LOG_STRDUP_MAX_STRING=1024
# configure Segger RTT
CONFIG_USE_SEGGER_RTT=y
CONFIG_SEGGER_RTT_BUFFER_SIZE_UP=4096

# configure bluetooth
CONFIG_BT=y
CONFIG_BT_PERIPHERAL=y
CONFIG_BT_DEVICE_NAME="EdgeImpulse"
CONFIG_BT_DEVICE_APPEARANCE=833
CONFIG_BT_MAX_CONN=1
CONFIG_BT_MAX_PAIRED=1

CONFIG_BT_SMP=y
CONFIG_BT_SIGNING=y
CONFIG_BT_BONDABLE=y
CONFIG_BT_CONN_TX_MAX=64
CONFIG_BT_SETTINGS=y
CONFIG_SETTINGS=y

CONFIG_BT_PERIPHERAL_PREF_MIN_INT=16
CONFIG_BT_PERIPHERAL_PREF_MAX_INT=16
CONFIG_BT_PERIPHERAL_PREF_LATENCY=0
CONFIG_BT_PERIPHERAL_PREF_TIMEOUT=100
CONFIG_BT_GAP_AUTO_UPDATE_CONN_PARAMS=y
CONFIG_BT_RX_STACK_SIZE=4096

CONFIG_CJSON_LIB=y

CONFIG_MCUBOOT_IMAGE_VERSION="1.0.0"
```

## src/main.cpp
```c
#include "ei_device_thingy53.h"
#include "ble/ei_ble_com.h"
#include "edge-impulse-sdk/porting/ei_classifier_porting.h"
#include "inference/ei_run_impulse.h"
#include "sensors/ei_microphone.h"
#include <drivers/uart.h>
#include <logging/log.h>
#include <nrfx_clock.h>
#include <zephyr.h>

#define LOG_MODULE_NAME main

LOG_MODULE_REGISTER(LOG_MODULE_NAME);

static const struct device *uart;

void ei_putchar(char c)
{
    uart_fifo_fill(uart, (const uint8_t*)&c, 1);
}

int main(void)
{
    EiDeviceThingy53 *dev = static_cast<EiDeviceThingy53*>(EiDeviceInfo::get_device());

    /* output of printf is output immediately without buffering */ 
    setvbuf(stdout, NULL, _IONBF, 0);

    /* Switch CPU core clock to 128 MHz */
    nrfx_clock_divider_set(NRF_CLOCK_DOMAIN_HFCLK, NRF_CLOCK_HFCLK_DIV_1);

    /* Initialize board uart */
    uart = device_get_binding("CDC_ACM_0");
    if (!uart) {
        LOG_ERR("Failed to init CDC_ACM_0\n");
    }

    /* Setup the microphone */
    if (ei_microphone_init() == false) {
         LOG_ERR("Microphone init failed!");
    }

    // init BLE stack
    ei_ble_com_init();

    // we have to do this later because the BLE stack is not available on boot
    dev->init_device_id();

    dev->set_state(eiStateFinished);

    // continuous=true, debug=false
    ei_start_impulse(true, false);
    dev->set_serial_channel(UART);

    ei_printf("Inferencing\n");
    while(1) {
        if (!is_inference_running()) {
            ei_printf("Inferencing Stopped\n");
        } else {
            ei_printf("Inferencing\n");
        }
        ei_sleep(1000);
    }
}

K_THREAD_DEFINE(inference_thread_id, CONFIG_EI_INFERENCE_THREAD_STACK,
                ei_inference_thread, NULL, NULL, NULL,
                CONFIG_EI_INFERENCE_THREAD_PRIO, 0, 0);
```

## src/buzzer.cpp
```c
/*
 * Copyright (c) 2021 Nordic Semiconductor ASA
 *
 * SPDX-License-Identifier: LicenseRef-Nordic-5-Clause
 */

#include "buzzer.h"

#include <zephyr/drivers/pwm.h>

static const struct pwm_dt_spec sBuzzer = PWM_DT_SPEC_GET(DT_ALIAS(buzzer_pwm));

static bool sBuzzerState;

int BuzzerInit()
{
	if (!device_is_ready(sBuzzer.dev)) {
		return -ENODEV;
	}
	return 0;
}

void BuzzerSetState(bool onOff)
{
	sBuzzerState = onOff;
	//pwm_set_pulse_dt(&sBuzzer, sBuzzerState ? (sBuzzer.period / 2) : 0);
	pwm_set_pulse_dt(&sBuzzer, sBuzzerState ? (sBuzzer.period / 2) : 0);
}

void BuzzerToggleState()
{
	BuzzerSetState(!sBuzzerState);
}
```
